## arch/arm/configs/msm8974_sec_eng_defconfig
```kconfig
CONFIG_MSM_L2_ERP_PRINT_ACCESS_ERRORS=y
# CONFIG_MSM_L2_ERP_PORT_PANIC is not set
# CONFIG_MSM_L2_ERP_1BIT_PANIC is not set
CONFIG_MSM_CACHE_DUMP=y
CONFIG_MSM_CACHE_DUMP_ON_PANIC=y
CONFIG_TSPP=m
CONFIG_DVB_CORE=m
CONFIG_DVB_MPQ=m
CONFIG_DVB_MPQ_DEMUX=m
CONFIG_MSM_IOMMU_PMON=y
CONFIG_LOCKUP_DETECTOR=y
CONFIG_UID_STAT=y
# CONFIG_DETECT_HUNG_TASK is not set
CONFIG_SCHEDSTATS=y
CONFIG_DEBUG_KMEMLEAK=y
CONFIG_DEBUG_KMEMLEAK_DEFAULT_OFF=y
CONFIG_DEBUG_SPINLOCK=y
CONFIG_DEBUG_MUTEXES=y
CONFIG_DEBUG_ATOMIC_SLEEP=y
CONFIG_DEBUG_STACK_USAGE=y
CONFIG_DEBUG_LIST=y
CONFIG_FAULT_INJECTION=y
CONFIG_FAIL_PAGE_ALLOC=y
CONFIG_FAULT_INJECTION_DEBUG_FS=y
CONFIG_FAULT_INJECTION_STACKTRACE_FILTER=y
# CONFIG_DEBUG_PAGEALLOC is not set
CONFIG_CPU_FREQ_SWITCH_PROFILER=y
CONFIG_DEBUG_LL=y
CONFIG_EARLY_PRINTK=y
CONFIG_ENABLE_DEFAULT_TRACERS=y
CONFIG_SEC_FILE_LEAK_DEBUG=y
CONFIG_CORESIGHT_ETM_DEFAULT_ENABLE=y
CONFIG_SLUB_DEBUG=y
CONFIG_SEC_LOGGER_BUFFER_EXPANSION=y
CONFIG_SEC_DEBUG_LMK_MEMINFO=y
CONFIG_SEC_DEBUG_ZERO_FD_CLOSE=y
CONFIG_SEC_DEBUG_SPINLOCK_PANIC=y
CONFIG_SYSFS=y
CONFIG_BLOCK=y
CONFIG_TRACING_SUPPORT=y
CONFIG_FTRACE=y
CONFIG_BLK_DEV_IO_TRACE=y
CONFIG_SEC_DEBUG_LIST_PANIC=y

# CONFIG_SEC_RESTRICT_ROOTING is not set
# CONFIG_SEC_RESTRICT_SETUID is not set
# CONFIG_SEC_RESTRICT_FORK is not set
# CONFIG_SEC_RESTRICT_ROOTING_LOG is not set
```

## arch/arm/configs/msm8974_sec_montblanc3g_ctc_defconfig
```kconfig
CONFIG_SEC_LOCALE_CHINA=y
CONFIG_SEC_OPERATOR_CTC=y
# CONFIG_MACH_H3GDUOS=y
CONFIG_MACH_MONTBLANC=y
CONFIG_LCD_CLASS_DEVICE=y
CONFIG_BACKLIGHT_LCD_SUPPORT=y
CONFIG_BACKLIGHT_CLASS_DEVICE=y
CONFIG_MDNIE_LITE_TUNING=y
CONFIG_FB_MSM_MIPI_SAMSUNG_OCTA_VIDEO_WVGA_S6E88A0_PT_PANEL=y
#
# ODE and DIR Encryption
#
CONFIG_CRYPTO=y
CONFIG_CRYPTO_SHA1=y
CONFIG_CRYPTO_SHA256=y
CONFIG_CRYPTO_AES=y
CONFIG_CRYPTO_CBC=y
CONFIG_ECRYPT_FS=y
CONFIG_WTL_ENCRYPTION_FILTER=y
CONFIG_KEYS=y
CONFIG_KEYS_DEBUG_PROC_KEYS=y

# INPUT Devices
# CONFIG_TOUCHSCREEN_SYNAPTICS_I2C_RMI is not set
# CONFIG_KEYBOARD_CYPRESS_TOUCH is not set
# CONFIG_INPUT_WACOM is not set
CONFIG_TOUCHSCREEN_ATMEL_MXT224S_KS02=y
CONFIG_KEYBOARD_MELFAS_TOUCHKEY=y

# key
CONFIG_KEYBOARD_MATRIX=y
CONFIG_KEYBOARD_PMIC8XXX=n
CONFIG_SENSORS_HALL=y

# BT
CONFIG_BT_L2CAP=y
CONFIG_BT_SCO=y
CONFIG_BT_HIDP=y
CONFIG_HID_SUPPORT=y
CONFIG_UHID=y
CONFIG_HID=y
CONFIG_HIDRAW=y
CONFIG_BT_HCISMD=n
CONFIG_BT_HCIUART_H4=y
CONFIG_BT_HCIUART_IBS=n
CONFIG_BT_HCIUART=y
CONFIG_BT_BCM4339=y
CONFIG_MSM_BT_POWER=n
CONFIG_SERIAL_MSM_HS=y
CONFIG_SERIAL_MSM_HSL=y

#
# MAX77803 Charger
#

# CONFIG_QPNP_CHARGER is not set
# CONFIG_QPNP_BMS is not set
CONFIG_BATTERY_SAMSUNG=y
CONFIG_SAMSUNG_LPM_MODE=y
CONFIG_FUELGAUGE_MAX17048=y
CONFIG_CHARGER_MAX77803=y

CONFIG_SENSORS_HALL=y
# CONFIG_GLOVE_TOUCH is not set
CONFIG_MMC_MSM_SDC3_SUPPORT=y

#
# Finger print sensor
#
#CONFIG_SENSORS_FINGERPRINT is not set
#CONFIG_SENSORS_VFS61XX is not set
#
# MAX77803 IC
#
CONFIG_MFD_MAX77803=y
CONFIG_REGULATOR_MAX77803=y
CONFIG_MOTOR_DRV_MAX77803=y
CONFIG_VIBETONZ=y
CONFIG_LEDS_MAX77803=y
#
# Actuator
#
CONFIG_I2C_ACTUATOR=y
#
# Sensor hub
#
CONFIG_SENSORS_SSP_STM=y
CONFIG_SENSORS_SSP_MAX88921=y
# CONFIG_BCM2079X_NFC_I2C=y

# Earjack
# CONFIG_SAMSUNG_JACK=y
CONFIG_INPUT_GPIO=y

#
# Remove Qualcomm Wifi features
#
CONFIG_MSM_PIL_PRONTO=n
CONFIG_WCNSS_CORE=n
CONFIG_WCNSS_CORE_PRONTO=n
#
# Wifi features (Broadcomm)
#
CONFIG_NET_CORE=y
CONFIG_WIRELESS=y
CONFIG_WIRELESS_EXT_SYSFS=y
CONFIG_WEXT_CORE=y
CONFIG_WEXT_PROC=y
CONFIG_CFG80211=y
CONFIG_CFG80211_DEFAULT_PS=y
CONFIG_CFG80211_ALLOW_RECONNECT=y
CONFIG_WLAN=y
CONFIG_WIFI_CONTROL_FUNC=y
CONFIG_BCM4335=m
CONFIG_BROADCOM_WIFI_RESERVED_MEM=y
CONFIG_WLAN_REGION_CODE=100
CONFIG_MMC_MSM_SDC2_SUPPORT=y
CONFIG_H_EUR_WIFI=y
#
# DWC3 usb 3.0 driver
#
CONFIG_USB_XHCI_HCD=y
CONFIG_USB_DWC3=y
CONFIG_USB_DWC3_MSM=y

## CHINA
#configs for modem interface
CONFIG_SEC_MODEM=y
CONFIG_GSM_MODEM_SPRD6500=y
CONFIG_SEC_DUAL_MODEM_MODE=y
CONFIG_LINK_DEVICE_SPI=y
CONFIG_WORKQUEUE_FRONT=y
CONFIG_SIM_SLOT_SWITCH=y
# Audience
CONFIG_SND_SOC_ES325=y
CONFIG_SND_SOC_ES325_SLIM=y
CONFIG_FW_LOADER=y
CONFIG_FIRMWARE_IN_KERNEL=y
CONFIG_EXTRA_FIRMWARE="audience-es325-fw.bin"
CONFIG_EXTRA_FIRMWARE_DIR="firmware"


# CONFIG_LEDS_AN30259A is not set

# LP8720
CONFIG_REGULATOR_LP8720=y
```

## drivers/input/touchscreen/synaptics_s5000/Kconfig
```kconfig
#
# SYNAPTICS TOUCH driver configuration
#
config TOUCHSCREEN_SYNAPTICS_I2C_RMI_S5000
	tristate "Synaptics i2c touchscreen"
	depends on I2C
	help
	  This enables support for Synaptics RMI over I2C based touchscreens.
	  use Synaptics S5000, S5050, S5707, S5708 IC.

config TOUCHSCREEN_SYNAPTICS_PREVENT_HSYNC_LEAKAGE
	bool "Synaptics prevent leakage i2c due to hsync"
	default n
	help
	  There is leakage current on TSP I2C by HW defect. TSP I2C Failed.
	  So To prevent leakage, hsync off, tsp on, hsync on.	  
```

## drivers/motor/Kconfig
```kconfig
#
# Immersion TouchSense Player driver configuration
#
menuconfig VIBETONZ
	tristate "Vibetonz"
	default n
	help
	Say Y to enable Vibetonz support.
	-------------
	-------------
	-------------

config MOTOR_DRV_MAX77803
	tristate "Maxim MAX77803 motor"
	default n

	depends on MFD_MAX77803
config MOTOR_DRV_ISA1400
	tristate "ISA1400 motor"
	default n
	depends on I2C
	help
	  Say Y to enalbe the ISA1400 IC.
```

## drivers/video/msm/mdss/Kconfig
```kconfig
config FB_MSM_MDSS_WRITEBACK
	bool "MDSS Writeback Panel"
	---help---
	The MDSS Writeback Panel provides support for routing the output of
	MDSS frame buffer driver and MDP processing to memory.

config FB_MSM_MDSS_HDMI_PANEL
	depends on FB_MSM_MDSS
	bool "MDSS HDMI Tx Panel"
	default n
	---help---
	The MDSS HDMI Panel provides support for transmitting TMDS signals of
	MDSS frame buffer data to connected hdmi compliant TVs, monitors etc.

config FB_MSM_MDSS_HDMI_MHL_SII8334
	depends on FB_MSM_MDSS_HDMI_PANEL
	bool 'MHL SII8334 support '
	default n
	---help---
	  Support the HDMI to MHL conversion.
	  MHL (Mobile High-Definition Link) technology
	  uses USB connector to output HDMI content

config MDNIE_LITE_TUNING
	bool "MDNIe lite panel tuning"
	default n

config FB_MSM_MIPI_SAMSUNG_OCTA_CMD_FULL_HD_PT_PANEL
	bool "Support SAMSUNG OCTA Command Full-HD Panel"
	default n

config MIPI_LCD_S6E3FA0_FORCE_VIDEO_MODE
	bool "Enforce DSI VIDEO Mode on S6E3FA0 panel"
	default n

config FB_MSM_MIPI_SAMSUNG_OCTA_VIDEO_WVGA_S6E88A0_PT_PANEL
	bool "Support SAMSUNG OCTA Video WVGA Panel"
	default n

config FB_MSM_CAMERA_CSC
	default n
	bool "Support SAMSUNG CAMERA CSC"
	---help---
		Support for camera CSC tuning

config FB_MSM_EDP_SAMSUNG
	bool "Support SAMSUNG EDP TCON"
	default n
```
